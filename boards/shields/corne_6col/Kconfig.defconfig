## boards/shields/corne_6col/Kconfig.defconfig
```kconfig
if SHIELD_CORNE_6COL_LEFT

config ZMK_KEYBOARD_NAME
    default "Corne 6col"

config ZMK_SPLIT_ROLE_CENTRAL
    default y

endif

if SHIELD_CORNE_6COL_LEFT || SHIELD_CORNE_6COL_RIGHT

config ZMK_SPLIT
    default y

endif
```

## boards/shields/corne_6col/Kconfig.shield
```kconfig
config SHIELD_CORNE_6COL_LEFT
    def_bool $(shields_list_contains,corne_6col_left)

config SHIELD_CORNE_6COL_RIGHT
    def_bool $(shields_list_contains,corne_6col_right)
```
